/*
 * class.dtso — Device Tree overlay for class
 * Auto-generated by: kdality dt-gen
 * Source: class.kdh
 */

/dts-v1/;
/plugin/;

/ {
    compatible = "simple-bus";
    #address-cells = <2>;
    #size-cells = <2>;

    fragment@0 {
        target-path = "/";
        __overlay__ {
            class@10000000 {
                compatible = "kdal,class";
                reg = <0x0 0x10000000 0x0 0x100>;
                status = "okay";
            };
        };
    };
};
